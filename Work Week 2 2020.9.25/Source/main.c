/*********************************************************************************************
* 文件：main.c
* 作者：Lixm 2017.10.17
* 说明：风扇实验 例程  
*       通过按键控制风扇开关，并将风扇的状态打印在PC上
* 修改：2017.11.08 chennian 将led、key文件替换为通用版驱动文件
*       2018.01.02 zhoucj   修改为串口一
* 注释： 
*********************************************************************************************/

/*********************************************************************************************
* 头文件
*********************************************************************************************/
#include <ioCC2530.h>
#include "clock.h"
#include "delay.h"
#include "fan.h"
#include "led.h"
#include "timer1.h"
#include "uart1.h"
#include "key.h"
#include "stdio.h"
#include "string.h"

/*********************************************************************************************
* 名称：main()
* 功能：逻辑代码
* 参数：无
* 返回：无
* 修改：
* 注释：
*********************************************************************************************/
unsigned int i = 20;
void main(void)
{
  xtal_init();                                                  //系统时钟初始化     
  led_init();                                                   //LED初始化
  fan_init();                                                   //风扇初始化
  uart1_init(0x00,0x00);                                        //串口初始化
  key_init();                                                   //按键初始化
//  timer1_init();
  while(1)
  {
    if(K4 == DOWN)                                              //按键按下，改变2个LED灯状态
    {
      delay_ms(10);                                             //按键防抖
      if(K4 == DOWN)                                            //按键按下，改变2个LED灯状态
      {                                    
          while(K4 == DOWN);
          LED6 = 0;  //OPen
           i=0;
           timer1_init();
 //         timer1_on();   //开启中断服务函数
          uart1_send_string("FAN ON! & Timer1 Start! \r\n");                     //串口打印提示信息
          //FAN = FAN_ON;                                         //开启风扇
      }
    }
 }
}
#pragma vector = T1_VECTOR //指定中断向量（查表）
__interrupt void T1_ISR(void){  //Timer1中断服务程序
  EA = 0;  //不允许外部中断请求
   i++;
  if(T1STAT & 0x20){
    if(i == 10){
      /*daima*/
      LED6 = 1;
      uart1_send_string("FAN OFF! \r\n"); 
      i=20;
 //     timer1_off();
      T1STAT = 0;             //清除中断标志位
    }
  }

  EA = 1;
}

